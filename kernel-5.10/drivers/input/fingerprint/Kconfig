## kernel-5.10/drivers/input/fingerprint/Kconfig
```kconfig
# SPDX-License-Identifier: GPL-2.0-only
#
# Input device configuration
#

menuconfig INPUT_FINGERPRINT_SUPPORT
	tristate "Support for fingerprint"
	help
	  Say Y here, and a list of supported fingerprint will be displayed.
	  This option doesn't affect the kernel.

	  If unsure, say Y.

if INPUT_FINGERPRINT_SUPPORT

source "drivers/input/fingerprint/hs07/Kconfig"

endif
```

## kernel-5.10/drivers/input/fingerprint/hs07/Kconfig
```kconfig
# SPDX-License-Identifier: GPL-2.0-only
#
# Input device configuration
#

config FINGERPRINT_HS07_SUPPORT
    tristate "HS07 Fingerprint support"
    help
        Fingerprint mtk driver enable/disable
        in the kernel.Say Y here if you want to
        use mediatek fingerprint driver,fingerprint
        driver will support fingerprint function

# HS07 code for SR-AL7761A-01-172 by hehaoran at 20250317 start
source "drivers/input/fingerprint/hs07/goodix/Kconfig"
# HS07 code for SR-AL7761A-01-172 by hehaoran at 20250317 end
# HS07 code for SR-AL7761A-01-185 by hehaoran at 20250311 start
source "drivers/input/fingerprint/hs07/jiiov/Kconfig"
# HS07 code for SR-AL7761A-01-185 by hehaoran at 20250311 end
# HS07 code for SR-AL7761A-01-518 by yuli at 20250315 start
source "drivers/input/fingerprint/hs07/silead/Kconfig"
# HS07 code for SR-AL7761A-01-518 by yuli at 20250315 end
source "drivers/input/fingerprint/hs07/focaltech/Kconfig"
```

## kernel-5.10/drivers/input/fingerprint/hs07/goodix/Kconfig
```kconfig
#
# GOODIX Fingerprint driver configuration
#

config FINGERPRINT_GOODIX
    tristate "GOODIX Fingerprint"
    default y
    help
      If you say Y to this option, support will be included for
      the GOODIX's fingerprint sensor. This driver supports
      both REE and TEE. If in REE, CONFIG_SPI_SPIDEV must be set
      to use the standard 'spidev' driver.
```

## kernel-5.10/drivers/input/hs07_sar/sx9378/Kconfig
```kconfig
#
# Input misc drivers configuration
#
config SAR_SX9378
    tristate "Support for sx9378 sar"
    help
      Say Y to enable the SAR detection application, if N here not to use the
      this SAR sensor
```

## kernel-5.10/drivers/input/hst11_sar/Kconfig
```kconfig
config INPUT_SAR
    tristate "Support for sar"
    help
      If the platform is supported for sar, this
      configuration should be configured, and the sar
      driver configuration should be configured as well.

source "drivers/input/hs07_sar/sx9378/Kconfig"
source "drivers/input/hs07_sar/hx9031as/Kconfig"
```

## kernel-5.10/drivers/input/hst11_sar/hx9031as/Kconfig
```kconfig
#
# Input misc drivers configuration
#
config SAR_HX9031
    tristate "Support for hx9031 sar"
    help
      Say Y to enable the SAR hx9031as detection application, if N here not to use the
      this SAR sensor
```

## kernel-5.10/drivers/misc/KnoxVault/Kconfig
```kconfig
config KNOXVAULT_POWER
    tristate "regulatore control of KnoxVault2"
    default n
    help
      Say y here if you have a KnoxVault2.
      If unsure, say N.
```

## kernel-5.10/drivers/power/supply/charge_pump/Kconfig
```kconfig
# HS07 code for HS07-12 by yexuedong at 20250221 start
config CHARGER_CP_PPS
	tristate "charge pump pps support"
	default n
	help
	  Say Y to enable support for charge pump pps
config NX853X_CP
	tristate "NX853X CP"
	depends on MTK_CHARGER
	help
	  Say Yes to enable
	  NX853X driver.
# HS07 code for HS07-12 by yexuedong at 20250221 end
# HS07 code for SR-AL7761A-01-167 by yexuedong at 20250307 start
config SP2131_CP
	tristate "SP2131 CP"
	depends on MTK_CHARGER
	help
	  Say Yes to enable
	  SP2131 driver.
# HS07 code for SR-AL7761A-01-167 by yexuedong at 20250307 end
# HS07 code for HS07-215 by huofudong at 20250326 start
config UPM6726_CP
	tristate "UPM6726 CP"
	depends on MTK_CHARGER
	help
	  Say Yes to enable
	  UPM6726 driver.
# HS07 code for HS07-215 by huofudong at 20250326 end
# HS07 code for HS07-2963 by yexuedong at 20250515 start
config SGM41608_CP
	tristate "SGM41608 CP"
	depends on MTK_CHARGER
	help
	  Say Yes to enable
	  SGM41608 driver.
# HS07 code for HS07-2963 by yexuedong at 20250515 end
```
