/*Tab A11 code for AX7800A-11 by huangzhixian at 20250409 start*/
/*Tab A11 code for AX7800A-19 by lichang at 20240410 start*/
&board_id {
        compatible = "odm,board-id-pin";
        board_id_num1 = <&pio 150 0>;
        board_id_num2 = <&pio 151 0>;
        board_id_num3 = <&pio 152 0>;
};
/*Tab A11 code for AX7800A-19 by lichang at 20240410 start*/
/*Tab A11 code for AX7800A-11 by huangzhixian at 20250409 end*/
