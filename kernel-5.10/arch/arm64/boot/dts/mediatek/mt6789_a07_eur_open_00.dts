/* 
 * Generated by Samsung 
 * If these files should be changed, then please make a sync with MTK
*/

/dts-v1/;
/plugin/;

#include "../mediatek/hs07.dts"
#include "mt6789-a07_common.dtsi"

/* Add Samsung configuration over here */
/ {
	compatible = "Samsung,A07 EUR OPEN 00", "Mediatek,MT6789";
	dtbo-hw_rev = <0x0>;
	dtbo-hw_rev_end = <0x20>;	
};

/*End of this file, DO NOT ADD ANYTHING HERE*/

